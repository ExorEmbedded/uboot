## arch/arm/mach-imx/imx8m/Kconfig
```kconfig
if ARCH_IMX8M

config IMX8M
	bool
	select HAS_CAAM
	select ROM_UNIFIED_SECTIONS

config IMX8MQ
	bool
	select IMX8M

config IMX8MM
	bool
	select IMX8M

config IMX8MN
	bool
	select IMX8M

choice
	prompt	"NXP i.MX8M board select"
	optional

config TARGET_IMX8MQ_EVK
	bool "imx8mq_evk"
	select IMX8MQ
	select SUPPORT_SPL
	select IMX8M_LPDDR4

config TARGET_IMX8MQ_DDR3L_ARM2
	bool "imx8mq_ddr3l_arm2"
	select IMX8MQ
	select SUPPORT_SPL

config TARGET_IMX8MQ_DDR4_ARM2
	bool "imx8mq_ddr4_arm2"
	select IMX8MQ
	select SUPPORT_SPL

config TARGET_IMX8MQ_PHANBELL
	bool "imx8mq_phanbell"
	select IMX8MQ
	select SUPPORT_SPL

config TARGET_IMX8MM_DDR4_VAL
	bool "imx8mm DDR4 validation board"
	select IMX8MM
	select SUPPORT_SPL

config TARGET_IMX8MM_DDR3L_VAL
	bool "imx8mm DDR3L validation board"
	select IMX8MM
	select SUPPORT_SPL

config TARGET_IMX8MM_EVK
	bool "imx8mm LPDDR4 EVK board"
	select IMX8MM
	select SUPPORT_SPL
	select IMX8M_LPDDR4

config TARGET_IMX8MM_US04
	bool "imx8mm LPDDR4 US04 board"
	select IMX8MM
	select SUPPORT_SPL
	select IMX8M_LPDDR4

config TARGET_IMX8MM_NS04
	bool "imx8mm 1GB DDR3L NS04 board"
	select IMX8MM
	select SUPPORT_SPL

config TARGET_IMX8MM_NS06
	bool "imx8mm 2GB LPDDR4 NS06 board"
	select IMX8MM
	select SUPPORT_SPL
	select IMX8M_LPDDR4
	
config TARGET_IMX8MN_NS05
	bool "imx8mn 1GB DDR3L NS05 board"
	select IMX8MN
	select SUPPORT_SPL
	
config TARGET_IMX8MM_DDR4_EVK
	bool "imx8mm DDR4 EVK board"
	select IMX8MM
	select SUPPORT_SPL
	select IMX8M_DDR4

config TARGET_IMX8MN_EVK
	bool "imx8mn DDR4 EVK board"
	select IMX8MN
	select SUPPORT_SPL
	select IMX8M_DDR4

endchoice

config SYS_SOC
	default "imx8m"

source "board/freescale/imx8mq_evk/Kconfig"
source "board/freescale/imx8mq_arm2/Kconfig"
source "board/freescale/imx8mq_phanbell/Kconfig"
source "board/freescale/imx8mm_evk/Kconfig"
source "board/freescale/imx8mm_val/Kconfig"
source "board/freescale/imx8mm_us04/Kconfig"
source "board/freescale/imx8mn_evk/Kconfig"

endif
```

## board/freescale/imx8mm_us04/Kconfig
```kconfig
if TARGET_IMX8MM_US04 || TARGET_IMX8MM_NS04 || TARGET_IMX8MN_NS05 || TARGET_IMX8MM_NS06

config SYS_BOARD
	default "imx8mm_us04"

config SYS_VENDOR
	default "freescale"

config SYS_CONFIG_NAME
	default "imx8mm_us04"

source "board/freescale/common/Kconfig"

endif
```

## board/freescale/imx8mp_us06/Kconfig
```kconfig
if TARGET_IMX8MP_US06

config SYS_BOARD
	default "imx8mp_us06"

config SYS_VENDOR
	default "freescale"

config SYS_CONFIG_NAME
	default "imx8mp_us06"

config IMX_CONFIG
	default "board/freescale/imx8mp_us06/imximage-8mp-lpddr4.cfg"

endif
```
